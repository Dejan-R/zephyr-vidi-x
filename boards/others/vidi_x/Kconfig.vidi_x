## boards/others/vidi_x/Kconfig.vidi_x
```kconfig
# SPDX-License-Identifier: Apache-2.0

config BOARD_VIDI_X
	select SOC_ESP32_WROVER_E_N4R8
	select SOC_ESP32_PROCPU if BOARD_VIDI_X_ESP32_PROCPU
```

## zephyr-vidi-x/boards/others/vidi_x/board.yml
```yaml
board:
  name: vidi_x
  full_name: VIDI X v1.0 (ESP32-WROVER-B)
  vendor: others
  socs:
  - name: esp32
```
